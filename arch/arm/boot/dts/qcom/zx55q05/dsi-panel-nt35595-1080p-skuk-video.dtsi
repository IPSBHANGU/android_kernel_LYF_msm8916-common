/* Copyright (c) 2013, The Linux Foundation. All rights reserved.
 *
 * This program is free software; you can redistribute it and/or modify
 * it under the terms of the GNU General Public License version 2 and
 * only version 2 as published by the Free Software Foundation.
 *
 * This program is distributed in the hope that it will be useful,
 * but WITHOUT ANY WARRANTY; without even the implied warranty of
 * MERCHANTABILITY or FITNESS FOR A PARTICULAR PURPOSE.  See the
 * GNU General Public License for more details.
 */

/*---------------------------------------------------------------------------
 * This file is autogenerated file using gcdb parser. Please do not edit it.
 * Update input XML file to add a new entry or update variable in this file
 * VERSION = "1.0"
 *---------------------------------------------------------------------------*/
&mdss_mdp {
	dsi_nt35595_1080p_skuk_video: qcom,mdss_dsi_nt35595_1080p_skuk_video {
				qcom,mdss-dsi-panel-name = "nt35595 1080p video mode dsi panel skuk";
				qcom,mdss-dsi-panel-controller = <&mdss_dsi0>;
				qcom,mdss-dsi-panel-type = "dsi_video_mode";
				qcom,mdss-dsi-panel-destination = "display_1";
				qcom,mdss-dsi-panel-framerate = <60>;
				qcom,mdss-dsi-virtual-channel-id = <0>;
				qcom,mdss-dsi-stream = <0>;
				qcom,mdss-dsi-panel-width = <1080>;
				qcom,mdss-dsi-panel-height = <1920>;
				qcom,mdss-dsi-h-front-porch = <120>;
				qcom,mdss-dsi-h-back-porch = <60>;
				qcom,mdss-dsi-h-pulse-width = <16>;
				qcom,mdss-dsi-h-sync-skew = <0>;
				qcom,mdss-dsi-v-back-porch = <10>;
				qcom,mdss-dsi-v-front-porch = <16>;
				qcom,mdss-dsi-v-pulse-width = <6>;
				qcom,mdss-dsi-h-left-border = <0>;
				qcom,mdss-dsi-h-right-border = <0>;
				qcom,mdss-dsi-v-top-border = <0>;
				qcom,mdss-dsi-v-bottom-border = <0>;
				qcom,mdss-dsi-bpp = <24>;
				qcom,mdss-dsi-color-order = "rgb_swap_rgb";
				qcom,mdss-dsi-underflow-color = < 0xff >;
				qcom,mdss-dsi-border-color = <0>;
				qcom,mdss-dsi-on-command = [ 29 01 00 00 00 00 02 ff ee 29 01 00 00 10 00 02 18 40 29 01 00 00 20 00 02 18 00 29 01 00 00 00 00 02 ff ff 29 01 00 00 00 00 02 16 00 29 01 00 00 00 00 02 fb 01 29 01 00 00 00 00 02 ff 01 29 01 00 00 00 00 02 00 01 29 01 00 00 00 00 02 01 55 29 01 00 00 00 00 02 02 40 29 01 00 00 00 00 02 05 40 29 01 00 00 00 00 02 06 4a 29 01 00 00 00 00 02 07 24 29 01 00 00 00 00 02 08 0c 29 01 00 00 00 00 02 0b 7d 29 01 00 00 00 00 02 0c 7d 29 01 00 00 00 00 02 0e b0 29 01 00 00 00 00 02 0f ae 29 01 00 00 00 00 02 11 10 29 01 00 00 00 00 02 12 10 29 01 00 00 00 00 02 13 03 29 01 00 00 00 00 02 14 4a 29 01 00 00 00 00 02 15 12 29 01 00 00 00 00 02 16 12 29 01 00 00 00 00 02 18 00 29 01 00 00 00 00 02 19 77 29 01 00 00 00 00 02 1a 55 29 01 00 00 00 00 02 1b 13 29 01 00 00 00 00 02 1c 00 29 01 00 00 00 00 02 1d 00 29 01 00 00 00 00 02 1e 13 29 01 00 00 00 00 02 1f 00 29 01 00 00 00 00 02 23 00 29 01 00 00 00 00 02 24 00 29 01 00 00 00 00 02 25 00 29 01 00 00 00 00 02 26 00 29 01 00 00 00 00 02 27 00 29 01 00 00 00 00 02 28 00 29 01 00 00 00 00 02 35 00 29 01 00 00 00 00 02 66 00 29 01 00 00 00 00 02 58 82 29 01 00 00 00 00 02 59 02 29 01 00 00 00 00 02 5a 02 29 01 00 00 00 00 02 5b 02 29 01 00 00 00 00 02 5c 82 29 01 00 00 00 00 02 5d 82 29 01 00 00 00 00 02 5e 02 29 01 00 00 00 00 02 5f 02 29 01 00 00 00 00 02 72 31 29 01 00 00 00 00 02 fb 01 29 01 00 00 00 00 02 ff 05 29 01 00 00 00 00 02 00 01 29 01 00 00 00 00 02 01 0b 29 01 00 00 00 00 02 02 0c 29 01 00 00 00 00 02 03 09 29 01 00 00 00 00 02 04 0a 29 01 00 00 00 00 02 05 00 29 01 00 00 00 00 02 06 0f 29 01 00 00 00 00 02 07 10 29 01 00 00 00 00 02 08 00 29 01 00 00 00 00 02 09 00 29 01 00 00 00 00 02 0a 00 29 01 00 00 00 00 02 0b 00 29 01 00 00 00 00 02 0c 00 29 01 00 00 00 00 02 0d 13 29 01 00 00 00 00 02 0e 15 29 01 00 00 00 00 02 0f 17 29 01 00 00 00 00 02 10 01 29 01 00 00 00 00 02 11 0b 29 01 00 00 00 00 02 12 0c 29 01 00 00 00 00 02 13 09 29 01 00 00 00 00 02 14 0a 29 01 00 00 00 00 02 15 00 29 01 00 00 00 00 02 16 0f 29 01 00 00 00 00 02 17 10 29 01 00 00 00 00 02 18 00 29 01 00 00 00 00 02 19 00 29 01 00 00 00 00 02 1a 00 29 01 00 00 00 00 02 1b 00 29 01 00 00 00 00 02 1c 00 29 01 00 00 00 00 02 1d 13 29 01 00 00 00 00 02 1e 15 29 01 00 00 00 00 02 1f 17 29 01 00 00 00 00 02 20 00 29 01 00 00 00 00 02 21 03 29 01 00 00 00 00 02 22 01 29 01 00 00 00 00 02 23 40 29 01 00 00 00 00 02 24 40 29 01 00 00 00 00 02 25 ed 29 01 00 00 00 00 02 29 58 29 01 00 00 00 00 02 2a 12 29 01 00 00 00 00 02 2b 01 29 01 00 00 00 00 02 4b 06 29 01 00 00 00 00 02 4c 11 29 01 00 00 00 00 02 4d 20 29 01 00 00 00 00 02 4e 02 29 01 00 00 00 00 02 4f 02 29 01 00 00 00 00 02 50 20 29 01 00 00 00 00 02 51 61 29 01 00 00 00 00 02 52 01 29 01 00 00 00 00 02 53 63 29 01 00 00 00 00 02 54 77 29 01 00 00 00 00 02 55 ed 29 01 00 00 00 00 02 5b 00 29 01 00 00 00 00 02 5c 00 29 01 00 00 00 00 02 5d 00 29 01 00 00 00 00 02 5e 00 29 01 00 00 00 00 02 5f 15 29 01 00 00 00 00 02 60 75 29 01 00 00 00 00 02 61 00 29 01 00 00 00 00 02 62 00 29 01 00 00 00 00 02 63 00 29 01 00 00 00 00 02 64 00 29 01 00 00 00 00 02 65 00 29 01 00 00 00 00 02 66 00 29 01 00 00 00 00 02 67 00 29 01 00 00 00 00 02 68 04 29 01 00 00 00 00 02 69 01 29 01 00 00 00 00 02 76 01 29 01 00 00 00 00 02 6c 40 29 01 00 00 00 00 02 7a 80 29 01 00 00 00 00 02 7b a3 29 01 00 00 00 00 02 7c d8 29 01 00 00 00 00 02 7d 60 29 01 00 00 00 00 02 7f 15 29 01 00 00 00 00 02 80 81 29 01 00 00 00 00 02 83 05 29 01 00 00 00 00 02 93 08 29 01 00 00 00 00 02 94 10 29 01 00 00 00 00 02 8a 00 29 01 00 00 00 00 02 9b 0f 29 01 00 00 00 00 02 fb 01 29 01 00 00 00 00 02 ff 01 29 01 00 00 00 00 02 75 00 29 01 00 00 00 00 02 76 18 29 01 00 00 00 00 02 77 00 29 01 00 00 00 00 02 78 16 29 01 00 00 00 00 02 79 00 29 01 00 00 00 00 02 7a 3d 29 01 00 00 00 00 02 7b 00 29 01 00 00 00 00 02 7c 5c 29 01 00 00 00 00 02 7d 00 29 01 00 00 00 00 02 7e 74 29 01 00 00 00 00 02 7f 00 29 01 00 00 00 00 02 80 89 29 01 00 00 00 00 02 81 00 29 01 00 00 00 00 02 82 9c 29 01 00 00 00 00 02 83 00 29 01 00 00 00 00 02 84 ad 29 01 00 00 00 00 02 85 00 29 01 00 00 00 00 02 86 bc 29 01 00 00 00 00 02 87 00 29 01 00 00 00 00 02 88 ef 29 01 00 00 00 00 02 89 01 29 01 00 00 00 00 02 8a 18 29 01 00 00 00 00 02 8b 01 29 01 00 00 00 00 02 8c 58 29 01 00 00 00 00 02 8d 01 29 01 00 00 00 00 02 8e 8a 29 01 00 00 00 00 02 8f 01 29 01 00 00 00 00 02 90 d7 29 01 00 00 00 00 02 91 02 29 01 00 00 00 00 02 92 12 29 01 00 00 00 00 02 93 02 29 01 00 00 00 00 02 94 14 29 01 00 00 00 00 02 95 02 29 01 00 00 00 00 02 96 49 29 01 00 00 00 00 02 97 02 29 01 00 00 00 00 02 98 80 29 01 00 00 00 00 02 99 02 29 01 00 00 00 00 02 9a a4 29 01 00 00 00 00 02 9b 02 29 01 00 00 00 00 02 9c d5 29 01 00 00 00 00 02 9d 02 29 01 00 00 00 00 02 9e f8 29 01 00 00 00 00 02 9f 03 29 01 00 00 00 00 02 a0 25 29 01 00 00 00 00 02 a2 03 29 01 00 00 00 00 02 a3 33 29 01 00 00 00 00 02 a4 03 29 01 00 00 00 00 02 a5 42 29 01 00 00 00 00 02 a6 03 29 01 00 00 00 00 02 a7 53 29 01 00 00 00 00 02 a9 03 29 01 00 00 00 00 02 aa 67 29 01 00 00 00 00 02 ab 03 29 01 00 00 00 00 02 ac 7e 29 01 00 00 00 00 02 ad 03 29 01 00 00 00 00 02 ae 9a 29 01 00 00 00 00 02 af 03 29 01 00 00 00 00 02 b0 ad 29 01 00 00 00 00 02 b1 03 29 01 00 00 00 00 02 b2 ff 29 01 00 00 00 00 02 b3 00 29 01 00 00 00 00 02 b4 00 29 01 00 00 00 00 02 b5 00 29 01 00 00 00 00 02 b6 16 29 01 00 00 00 00 02 b7 00 29 01 00 00 00 00 02 b8 3d 29 01 00 00 00 00 02 b9 00 29 01 00 00 00 00 02 ba 5c 29 01 00 00 00 00 02 bb 00 29 01 00 00 00 00 02 bc 74 29 01 00 00 00 00 02 bd 00 29 01 00 00 00 00 02 be 89 29 01 00 00 00 00 02 bf 00 29 01 00 00 00 00 02 c0 9c 29 01 00 00 00 00 02 c2 ad 29 01 00 00 00 00 02 c3 00 29 01 00 00 00 00 02 c4 bc 29 01 00 00 00 00 02 c5 00 29 01 00 00 00 00 02 c6 ef 29 01 00 00 00 00 02 c7 01 29 01 00 00 00 00 02 c8 18 29 01 00 00 00 00 02 c9 01 29 01 00 00 00 00 02 ca 58 29 01 00 00 00 00 02 cb 01 29 01 00 00 00 00 02 cc 8a 29 01 00 00 00 00 02 cd 01 29 01 00 00 00 00 02 ce d7 29 01 00 00 00 00 02 cf 02 29 01 00 00 00 00 02 d0 12 29 01 00 00 00 00 02 d1 02 29 01 00 00 00 00 02 d2 14 29 01 00 00 00 00 02 d3 02 29 01 00 00 00 00 02 d4 49 29 01 00 00 00 00 02 d5 02 29 01 00 00 00 00 02 d6 80 29 01 00 00 00 00 02 d7 02 29 01 00 00 00 00 02 d8 a4 29 01 00 00 00 00 02 d9 02 29 01 00 00 00 00 02 da d5 29 01 00 00 00 00 02 db 02 29 01 00 00 00 00 02 dc f8 29 01 00 00 00 00 02 dd 03 29 01 00 00 00 00 02 de 25 29 01 00 00 00 00 02 df 03 29 01 00 00 00 00 02 e0 33 29 01 00 00 00 00 02 e1 03 29 01 00 00 00 00 02 e2 42 29 01 00 00 00 00 02 e3 03 29 01 00 00 00 00 02 e4 53 29 01 00 00 00 00 02 e5 03 29 01 00 00 00 00 02 e6 67 29 01 00 00 00 00 02 e7 03 29 01 00 00 00 00 02 e8 7e 29 01 00 00 00 00 02 e9 03 29 01 00 00 00 00 02 ea 9a 29 01 00 00 00 00 02 eb 03 29 01 00 00 00 00 02 ec bd 29 01 00 00 00 00 02 ed 03 29 01 00 00 00 00 02 ee ff 29 01 00 00 00 00 02 ef 00 29 01 00 00 00 00 02 f0 00 29 01 00 00 00 00 02 f1 00 29 01 00 00 00 00 02 f2 16 29 01 00 00 00 00 02 f3 00 29 01 00 00 00 00 02 f4 3d 29 01 00 00 00 00 02 f5 00 29 01 00 00 00 00 02 f6 5c 29 01 00 00 00 00 02 f7 00 29 01 00 00 00 00 02 f8 74 29 01 00 00 00 00 02 f9 00 29 01 00 00 00 00 02 fa 89 29 01 00 00 00 00 02 fb 01 29 01 00 00 00 00 02 ff 02 29 01 00 00 00 00 02 00 00 29 01 00 00 00 00 02 01 9c 29 01 00 00 00 00 02 02 00 29 01 00 00 00 00 02 03 ad 29 01 00 00 00 00 02 04 00 29 01 00 00 00 00 02 05 bc 29 01 00 00 00 00 02 06 00 29 01 00 00 00 00 02 07 ef 29 01 00 00 00 00 02 08 01 29 01 00 00 00 00 02 09 18 29 01 00 00 00 00 02 0a 01 29 01 00 00 00 00 02 0b 58 29 01 00 00 00 00 02 0c 01 29 01 00 00 00 00 02 0d 8a 29 01 00 00 00 00 02 0e 01 29 01 00 00 00 00 02 0f d7 29 01 00 00 00 00 02 10 02 29 01 00 00 00 00 02 11 12 29 01 00 00 00 00 02 12 02 29 01 00 00 00 00 02 13 14 29 01 00 00 00 00 02 14 02 29 01 00 00 00 00 02 15 49 29 01 00 00 00 00 02 16 02 29 01 00 00 00 00 02 17 80 29 01 00 00 00 00 02 18 02 29 01 00 00 00 00 02 19 a4 29 01 00 00 00 00 02 1a 02 29 01 00 00 00 00 02 1b d5 29 01 00 00 00 00 02 1c 02 29 01 00 00 00 00 02 1d f8 29 01 00 00 00 00 02 1e 03 29 01 00 00 00 00 02 1f 25 29 01 00 00 00 00 02 20 03 29 01 00 00 00 00 02 21 33 29 01 00 00 00 00 02 22 03 29 01 00 00 00 00 02 23 42 29 01 00 00 00 00 02 24 03 29 01 00 00 00 00 02 25 53 29 01 00 00 00 00 02 26 03 29 01 00 00 00 00 02 27 67 29 01 00 00 00 00 02 28 03 29 01 00 00 00 00 02 29 7e 29 01 00 00 00 00 02 2a 03 29 01 00 00 00 00 02 2b 9a 29 01 00 00 00 00 02 2d 03 29 01 00 00 00 00 02 2f bd 29 01 00 00 00 00 02 30 03 29 01 00 00 00 00 02 31 ff 29 01 00 00 00 00 02 32 00 29 01 00 00 00 00 02 33 00 29 01 00 00 00 00 02 34 00 29 01 00 00 00 00 02 35 16 29 01 00 00 00 00 02 36 00 29 01 00 00 00 00 02 37 3d 29 01 00 00 00 00 02 38 00 29 01 00 00 00 00 02 39 5c 29 01 00 00 00 00 02 3a 00 29 01 00 00 00 00 02 3b 74 29 01 00 00 00 00 02 3d 00 29 01 00 00 00 00 02 3f 89 29 01 00 00 00 00 02 40 00 29 01 00 00 00 00 02 41 9c 29 01 00 00 00 00 02 42 00 29 01 00 00 00 00 02 43 ad 29 01 00 00 00 00 02 44 00 29 01 00 00 00 00 02 45 bc 29 01 00 00 00 00 02 46 00 29 01 00 00 00 00 02 47 ef 29 01 00 00 00 00 02 48 01 29 01 00 00 00 00 02 49 18 29 01 00 00 00 00 02 4a 01 29 01 00 00 00 00 02 4b 58 29 01 00 00 00 00 02 4c 01 29 01 00 00 00 00 02 4d 8a 29 01 00 00 00 00 02 4e 01 29 01 00 00 00 00 02 4f d7 29 01 00 00 00 00 02 50 02 29 01 00 00 00 00 02 51 12 29 01 00 00 00 00 02 52 02 29 01 00 00 00 00 02 53 14 29 01 00 00 00 00 02 54 02 29 01 00 00 00 00 02 55 49 29 01 00 00 00 00 02 56 02 29 01 00 00 00 00 02 58 80 29 01 00 00 00 00 02 59 02 29 01 00 00 00 00 02 5a a4 29 01 00 00 00 00 02 5b 02 29 01 00 00 00 00 02 5c d5 29 01 00 00 00 00 02 5d 02 29 01 00 00 00 00 02 5e f8 29 01 00 00 00 00 02 5f 03 29 01 00 00 00 00 02 60 25 29 01 00 00 00 00 02 61 03 29 01 00 00 00 00 02 62 33 29 01 00 00 00 00 02 63 03 29 01 00 00 00 00 02 64 53 29 01 00 00 00 00 02 65 03 29 01 00 00 00 00 02 66 71 29 01 00 00 00 00 02 67 03 29 01 00 00 00 00 02 68 67 29 01 00 00 00 00 02 69 03 29 01 00 00 00 00 02 6a 7e 29 01 00 00 00 00 02 6b 03 29 01 00 00 00 00 02 6c 9a 29 01 00 00 00 00 02 6d 03 29 01 00 00 00 00 02 6e bd 29 01 00 00 00 00 02 6f 03 29 01 00 00 00 00 02 70 ff 29 01 00 00 00 00 02 71 00 29 01 00 00 00 00 02 72 00 29 01 00 00 00 00 02 73 00 29 01 00 00 00 00 02 74 16 29 01 00 00 00 00 02 75 00 29 01 00 00 00 00 02 76 3d 29 01 00 00 00 00 02 77 00 29 01 00 00 00 00 02 78 5c 29 01 00 00 00 00 02 79 00 29 01 00 00 00 00 02 7a 74 29 01 00 00 00 00 02 7b 00 29 01 00 00 00 00 02 7c 89 29 01 00 00 00 00 02 7d 00 29 01 00 00 00 00 02 7e 9c 29 01 00 00 00 00 02 7f 00 29 01 00 00 00 00 02 80 ad 29 01 00 00 00 00 02 81 00 29 01 00 00 00 00 02 82 bc 29 01 00 00 00 00 02 83 00 29 01 00 00 00 00 02 84 ff 29 01 00 00 00 00 02 85 01 29 01 00 00 00 00 02 86 18 29 01 00 00 00 00 02 87 01 29 01 00 00 00 00 02 88 58 29 01 00 00 00 00 02 89 01 29 01 00 00 00 00 02 8a 8a 29 01 00 00 00 00 02 8b 01 29 01 00 00 00 00 02 8c d7 29 01 00 00 00 00 02 8d 02 29 01 00 00 00 00 02 8e 12 29 01 00 00 00 00 02 8f 02 29 01 00 00 00 00 02 90 14 29 01 00 00 00 00 02 91 02 29 01 00 00 00 00 02 92 49 29 01 00 00 00 00 02 93 02 29 01 00 00 00 00 02 94 80 29 01 00 00 00 00 02 95 02 29 01 00 00 00 00 02 96 a4 29 01 00 00 00 00 02 97 02 29 01 00 00 00 00 02 98 d5 29 01 00 00 00 00 02 99 02 29 01 00 00 00 00 02 9a f8 29 01 00 00 00 00 02 9b 03 29 01 00 00 00 00 02 9c 25 29 01 00 00 00 00 02 9d 03 29 01 00 00 00 00 02 9e 33 29 01 00 00 00 00 02 9f 03 29 01 00 00 00 00 02 a0 42 29 01 00 00 00 00 02 a2 03 29 01 00 00 00 00 02 a3 53 29 01 00 00 00 00 02 a4 03 29 01 00 00 00 00 02 a5 67 29 01 00 00 00 00 02 a6 03 29 01 00 00 00 00 02 a7 9a 29 01 00 00 00 00 02 a9 03 29 01 00 00 00 00 02 aa a3 29 01 00 00 00 00 02 ab 03 29 01 00 00 00 00 02 ac bd 29 01 00 00 00 00 02 ad 03 29 01 00 00 00 00 02 ae ff 29 01 00 00 00 00 02 af 00 29 01 00 00 00 00 02 b0 00 29 01 00 00 00 00 02 b1 00 29 01 00 00 00 00 02 b2 16 29 01 00 00 00 00 02 b3 00 29 01 00 00 00 00 02 b4 3d 29 01 00 00 00 00 02 b5 00 29 01 00 00 00 00 02 b6 5c 29 01 00 00 00 00 02 b7 00 29 01 00 00 00 00 02 b8 74 29 01 00 00 00 00 02 b9 00 29 01 00 00 00 00 02 ba 89 29 01 00 00 00 00 02 bb 00 29 01 00 00 00 00 02 bc 9c 29 01 00 00 00 00 02 bd 00 29 01 00 00 00 00 02 be ad 29 01 00 00 00 00 02 bf 00 29 01 00 00 00 00 02 c0 bc 29 01 00 00 00 00 02 c1 00 29 01 00 00 00 00 02 c2 ef 29 01 00 00 00 00 02 c3 01 29 01 00 00 00 00 02 c4 18 29 01 00 00 00 00 02 c5 01 29 01 00 00 00 00 02 c6 58 29 01 00 00 00 00 02 c7 01 29 01 00 00 00 00 02 c8 8a 29 01 00 00 00 00 02 c9 01 29 01 00 00 00 00 02 ca d7 29 01 00 00 00 00 02 cb 02 29 01 00 00 00 00 02 cc 12 29 01 00 00 00 00 02 cd 02 29 01 00 00 00 00 02 ce 14 29 01 00 00 00 00 02 cf 02 29 01 00 00 00 00 02 d0 49 29 01 00 00 00 00 02 d1 02 29 01 00 00 00 00 02 d2 80 29 01 00 00 00 00 02 d3 02 29 01 00 00 00 00 02 d4 a4 29 01 00 00 00 00 02 d5 02 29 01 00 00 00 00 02 d6 d5 29 01 00 00 00 00 02 d7 02 29 01 00 00 00 00 02 d8 f8 29 01 00 00 00 00 02 d9 03 29 01 00 00 00 00 02 da 25 29 01 00 00 00 00 02 db 03 29 01 00 00 00 00 02 dc 33 29 01 00 00 00 00 02 dd 03 29 01 00 00 00 00 02 de 42 29 01 00 00 00 00 02 df 03 29 01 00 00 00 00 02 e0 53 29 01 00 00 00 00 02 e1 03 29 01 00 00 00 00 02 e2 67 29 01 00 00 00 00 02 e3 03 29 01 00 00 00 00 02 e4 7e 29 01 00 00 00 00 02 e5 03 29 01 00 00 00 00 02 e6 9a 29 01 00 00 00 00 02 e7 03 29 01 00 00 00 00 02 e8 bd 29 01 00 00 00 00 02 e9 03 29 01 00 00 00 00 02 ea ff 29 01 00 00 00 00 02 ff 01 29 01 00 00 00 00 02 fb 01 29 01 00 00 00 00 02 ff 02 29 01 00 00 00 00 02 fb 01 29 01 00 00 00 00 02 ff 04 29 01 00 00 00 00 02 fb 01 29 01 00 00 00 00 02 ff 05 29 01 00 00 00 00 02 fb 01 29 01 00 00 00 00 02 e7 a3 29 01 00 00 00 00 02 ff 00 29 01 00 00 00 00 02 d3 10 29 01 00 00 00 00 02 d4 10 29 01 00 00 00 00 02 ff 00 29 01 00 00 00 00 02 35 00 29 01 00 00 00 00 02 36 00 29 01 00 00 78 00 02 11 00 29 01 00 00 64 00 02 29 00 29 01 00 00 00 00 02 ff ee 29 01 00 00 00 00 02 24 4f 29 01 00 00 00 00 02 38 c8 29 01 00 00 00 00 02 39 27 29 01 00 00 00 00 02 1e 77 29 01 00 00 00 00 02 1d 0f 29 01 00 00 00 00 02 75 10 29 01 00 00 00 00 02 7e 71 29 01 00 00 00 00 02 7c 03 29 01 00 00 00 00 02 ff 00 37 01 00 00 00 00 02 02 00 ];
				qcom,mdss-dsi-off-command = [ 05 01 00 00 32 00 02 28 00
							05 01 00 00 78 00 02 10 00 ];
				qcom,mdss-dsi-on-command-state = "dsi_lp_mode";
				qcom,mdss-dsi-off-command-state = "dsi_hs_mode";
				qcom,mdss-dsi-panel-status-check-mode = "bta_check";
				qcom,mdss-dsi-h-sync-pulse = <1>;
				qcom,mdss-dsi-traffic-mode = "burst_mode";
				qcom,mdss-dsi-lane-map = "lane_map_0123";
				qcom,mdss-dsi-bllp-eof-power-mode;
				qcom,mdss-dsi-bllp-power-mode;
				qcom,mdss-dsi-force-clock-lane-hs;
				qcom,mdss-dsi-lane-0-state;
				qcom,mdss-dsi-lane-1-state;
				qcom,mdss-dsi-lane-2-state;
				qcom,mdss-dsi-lane-3-state;
				qcom,mdss-dsi-panel-timings = [E6 38 26 00 68 6C 28 3C 2C 03 04 00];
				qcom,mdss-dsi-t-clk-post = <0x3>;
				qcom,mdss-dsi-t-clk-pre = <0x2B>;
				qcom,mdss-dsi-bl-min-level = <1>;
				qcom,mdss-dsi-bl-max-level = <255>;
				qcom,mdss-dsi-bl-pmic-pwm-frequency = <100>;
				qcom,mdss-dsi-bl-pmic-bank-select = <0>;
				qcom,mdss-dsi-dma-trigger = "trigger_sw";
				qcom,mdss-dsi-mdp-trigger = "none";
				qcom,mdss-dsi-bl-pmic-control-type = "bl_ctrl_pwm";
				qcom,mdss-dsi-reset-sequence = <1 40>, <0 20>, <1 40>, <0 20>, <1 40>;
	};
};
